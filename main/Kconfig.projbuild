## main/Kconfig.projbuild
```kconfig
menu "Waveshare ESP32S3 3.5in LCD Touch Configuration"

    orsource "$IDF_PATH/examples/common_components/env_caps/$IDF_TARGET/Kconfig.env_caps"

    menu "Program Settings"
        config ESP32S3_PROGRAM_NAME
            string "Program name"
            default "ESP32S3_AXS15231B_3.5in_LCD_Touch"
            help
               Select a name for yours program. It will be used as the TAG in log messages.
        
        config ESP32S3_PROGRAM_ENABLE_TIMER_WATERMARK_MONITORING
            bool "Enable Timer Task Stack Watermark Monitoring"
            default n
            help
                Enable this option to monitor the stack usage of the FreeRTOS timer task.
                When enabled, the program will periodically log the minimum free stack
                space of the timer task, which can help in identifying stack overflows
                or memory issues.
    endmenu

    menu "Screen Settings"
        config ESP32S3_SCREENSAVER_TIMEOUT
            int "Screensaver activation time in seconds"
            default 30
            range 5 300
            help
                Select the amount of time, in seconds, before the screensaver activates.

        config ESP32S3_SCREEN_BRIGHTNESS
            int "Screen brightness (0-100%) always on startup"
            default 50
            range 0 100
            help
                Select the initial screen brightness as a percentage (0-100%).

    endmenu

    menu "LVGL Settings"
        config ESP32S3_LVGL_TASK_PRIORITY
            int "LVGL FreeRTOS task priority"
            default 2
            range 2 28
            help
                Select the FreeRTOS task priority for the LVGL task.

        config ESP32S3_LVGL_TIMER_PERIOD_MS
            int "LVGL timer period in milliseconds"
            default 40
            range 10 100
            help
                Select the FreeRTOS timer period.
    endmenu

endmenu
```

## sdkconfig.defaults
```kconfig
#
# ESP PSRAM
#
CONFIG_SPIRAM=y

#
# SPI RAM config
#
CONFIG_SPIRAM_MODE_OCT=y
CONFIG_SPIRAM_TYPE_AUTO=y
CONFIG_SPIRAM_CLK_IO=30
CONFIG_SPIRAM_CS_IO=26
CONFIG_SPIRAM_SPEED_80M=y
CONFIG_SPIRAM_SPEED=80
CONFIG_SPIRAM_BOOT_HW_INIT=y
CONFIG_SPIRAM_BOOT_INIT=y
CONFIG_SPIRAM_PRE_CONFIGURE_MEMORY_PROTECTION=y
CONFIG_SPIRAM_USE_MALLOC=y
CONFIG_SPIRAM_MEMTEST=y
CONFIG_SPIRAM_MALLOC_ALWAYSINTERNAL=16384
CONFIG_SPIRAM_MALLOC_RESERVE_INTERNAL=32768

#
# FreeRTOS software timer stack size
#
CONFIG_TIMER_TASK_STACK_SIZE=3584
```
